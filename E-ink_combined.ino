/*
  Iver Iscariot Søbakk's E-ink display tide-watch

  NTP-library: https://github.com/taranais/NTPClient
*/

// BUSY -> 25, RST -> 26, DC -> 27, CS-> 15, CLK -> 13, DIN -> 14

#define USE_HSPI_FOR_EPD
#define ENABLE_GxEPD2_GFX 0

#include <GxEPD2_BW.h>
#include <Fonts/FreeMonoBold9pt7b.h>


// ###################################################################################################################
// ###################################################################################################################
// ######################### mumbo jumbo display defines #############################################################
#define GxEPD2_DISPLAY_CLASS GxEPD2_BW
#define GxEPD2_DRIVER_CLASS GxEPD2_154     // GDEP015OC1  200x200, IL3829, (WFC0000CZ07), no longer available

#define GxEPD2_BW_IS_GxEPD2_BW true
#define GxEPD2_1248_IS_GxEPD2_1248 true
#define IS_GxEPD(c, x) (c##x)
#define IS_GxEPD2_BW(x) IS_GxEPD(GxEPD2_BW_IS_, x)
#define IS_GxEPD2_1248(x) IS_GxEPD(GxEPD2_1248_IS_, x)


#if defined(ESP32)
#define MAX_DISPLAY_BUFFER_SIZE 65536ul // e.g.
#if IS_GxEPD2_BW(GxEPD2_DISPLAY_CLASS)
#define MAX_HEIGHT(EPD) (EPD::HEIGHT <= MAX_DISPLAY_BUFFER_SIZE / (EPD::WIDTH / 8) ? EPD::HEIGHT : MAX_DISPLAY_BUFFER_SIZE / (EPD::WIDTH / 8))
#elif IS_GxEPD2_3C(GxEPD2_DISPLAY_CLASS)
#define MAX_HEIGHT(EPD) (EPD::HEIGHT <= (MAX_DISPLAY_BUFFER_SIZE / 2) / (EPD::WIDTH / 8) ? EPD::HEIGHT : (MAX_DISPLAY_BUFFER_SIZE / 2) / (EPD::WIDTH / 8))
#elif IS_GxEPD2_7C(GxEPD2_DISPLAY_CLASS)
#define MAX_HEIGHT(EPD) (EPD::HEIGHT <= (MAX_DISPLAY_BUFFER_SIZE) / (EPD::WIDTH / 2) ? EPD::HEIGHT : (MAX_DISPLAY_BUFFER_SIZE) / (EPD::WIDTH / 2))
#endif
GxEPD2_DISPLAY_CLASS<GxEPD2_DRIVER_CLASS, MAX_HEIGHT(GxEPD2_DRIVER_CLASS)> display(GxEPD2_DRIVER_CLASS(/*CS=*/ 15, /*DC=*/ 27, /*RST=*/ 26, /*BUSY=*/ 25));
#endif


#if defined(ESP32) && defined(USE_HSPI_FOR_EPD)
SPIClass hspi(HSPI);
#endif
// ###################################################################################################################
// ###################################################################################################################


#include <WiFi.h>
#include <HTTPClient.h>
#include "TimeLib.h"
#include <Arduino.h>
#include <NTPClient.h>
#include <WiFiUdp.h>
#include <ESP32Time.h>




// /\/\/\/\/\/\/\/\/\/\/\/\/\/\/\/\/\/\/\/\/\/\/\/\/\/\/\/\/\/\/\/\/\/\/\/
// /\/\/\/\/\/\/\/\/\/\/ user defined variables \/\/\/\/\/\/\/\/\/\/\/\/\/

const char lat[]      =  "59.887540";
const char lon[]      =  "10.714747";

const byte nDays      =  3;                  // Antall dager med data du laster ned når du trykker synk
const byte gmtOffset  =  1;                  // Tidssonen vi bruker

const char* ssid      =  "123";
const char* password  =  "12345678";

// /\/\/\/\/\/\/\/\/\/\/\/\/\/\/\/\/\/\/\/\/\/\/\/\/\/\/\/\/\/\/\/\/\/\/\/
// /\/\/\/\/\/\/\/\/\/\/\/\/\/\/\/\/\/\/\/\/\/\/\/\/\/\/\/\/\/\/\/\/\/\/\/
const byte screenRot = 3;



// Define NTP Client to get time
WiFiUDP ntpUDP;
NTPClient timeClient(ntpUDP);

// Variables to save date and time
String formattedDate;
String dayStamp;
String timeStamp;

//ESP32Time rtc;
ESP32Time rtc(gmtOffset*3600);  // offset in seconds GMT+1

//Your Domain name with URL path or IP address with path
String serverName = "https://api.sehavniva.no/tideapi.php";

const int nHours = nDays*24;

struct tide_t{
  int Level[nHours];
  time_t Time[nHours];
};

tide_t tideData;

const unsigned char cat [] PROGMEM = {
	0xff, 0xff, 0xff, 0xff, 0xff, 0xff, 0xff, 0xff, 0xff, 0xff, 0xff, 0xff, 0xff, 0xff, 0xff, 0xf7, 
	0xb7, 0xd4, 0x90, 0xee, 0xdb, 0xee, 0xff, 0xfe, 0xff, 0xff, 0xfd, 0xb5, 0xaa, 0xaa, 0xaa, 0xaa, 
	0xaa, 0xaa, 0xbd, 0xed, 0x75, 0x48, 0xbf, 0xfe, 0xfb, 0xd6, 0xdb, 0xdb, 0x6d, 0xaf, 0xff, 0xff, 
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	0x40, 0x8d, 0xa8
};


void setup() {
  Serial.begin(9600); 
  
  delay(1000);
  Serial.println();
  Serial.println("updating tide data... ");
  // TODO: finn ut hvordan du passer listen og oppdaterer den
  tideData = updateTide();
  Serial.println("Exited updateTide function");


  // *** special handling for Waveshare ESP32 Driver board *** //
  // ********************************************************* //
    #if defined(ESP32) && defined(USE_HSPI_FOR_EPD)
      hspi.begin(13, 12, 14, 15); // remap hspi for EPD (swap pins)
      display.epd2.selectSPI(hspi, SPISettings(4000000, MSBFIRST, SPI_MODE0));
    #endif
  // *** end of special handling for Waveshare ESP32 Driver board *** //
  // **************************************************************** //
  
  display.init(9600);

  bootScreen();
  drawCurve();
}

tide_t updateTide(){
  tide_t localTide;

  WiFi.begin(ssid, password);
  Serial.println("Connecting");
  while(WiFi.status() != WL_CONNECTED) {
    delay(500);
    Serial.print(".");
  }
  Serial.println("");
  Serial.print("Connected to WiFi network with IP Address: ");
  Serial.println(WiFi.localIP());



  // ###########################################################################################################################################
  // ##################################   tidssynk kall  #######################################################################################
  timeClient.begin();
  timeClient.setTimeOffset(gmtOffset*3600);
  while(!timeClient.update()) {
    timeClient.forceUpdate();
  }

  formattedDate = timeClient.getFormattedDate();
  //Serial.println(formattedDate);
  
  int splitT = formattedDate.indexOf("T");
  dayStamp = formattedDate.substring(0, splitT);
  Serial.print("DATE: ");
  Serial.println(dayStamp);
  
  timeStamp = formattedDate.substring(splitT+1, formattedDate.length()-1);
  //Serial.print("HOUR: ");
  //Serial.println(timeStamp);

  Serial.print("HOUR: ");
  Serial.print(timeClient.getHours() + gmtOffset);
  Serial.print(":");
  Serial.print(timeClient.getMinutes());
  Serial.print(":");
  Serial.println(timeClient.getSeconds());

  rtc.setTime(timeClient.getEpochTime());  // Sett den interne klokken til ESP32 etter det NTP serveren sier
  Serial.println();
  Serial.println("RTC time: ");
  Serial.print("DATE: ");
  Serial.println(rtc.getDate());
  Serial.print("HOUR: ");
  Serial.println(rtc.getTime());



  
  // ###########################################################################################################################################
  // ##################################   TIDEVANN API-KALL  ###################################################################################
  //Check WiFi connection status
  if(WiFi.status()== WL_CONNECTED){
    HTTPClient http;
    

    // #################################################################################
    // Generate url query with our set data
    String serverPath = serverName + "?lat=";
    serverPath += lat;
    serverPath += "&lon=";
    serverPath += lon;
    serverPath += urlDate(rtc.getYear(), rtc.getMonth(), rtc.getDay(), nDays);
    serverPath += "&datatype=pre&refcode=cd&place=lindoya&file=&lang=nb&interval=60&dst=0&tzone=1&tide_request=locationdata";
    //
    // #################################################################################


    // Your Domain name with URL path or IP address with path
    http.begin(serverPath.c_str());
    
    // If you need Node-RED/server authentication, insert user and password below
    //http.setAuthorization("REPLACE_WITH_SERVER_USERNAME", "REPLACE_WITH_SERVER_PASSWORD");
    
    // Send HTTP GET request
    int httpResponseCode = http.GET();
    
    
    if (httpResponseCode>0) {
      //Serial.println("HTTP Response code: ");
      //Serial.println(httpResponseCode);
      String payload = http.getString();  // Hent ut hele xml filen som en string
      //Serial.println(payload);
      
      int listIndex = 0;  // index for hvor i listen jeg legger inn dataene, siden append ikke er en greie i C

      for(int i = 6; i < payload.length() - 10; i++){  // se gjennom XML-fil-strengen (itterer hver char), minus kantene, siden jeg ser etter en 5 char substring 

        // format på XML linje:
        // <waterlevel value="61.5" time="2024-06-26T00:00:00+01:00" flag="pre"/>

        if(payload.substring(i-5,i) == "alue="){  // hvis vi er rett foran tallverdien   -  value="XX.X"

          localTide.Level[listIndex] = int(payload.substring(i+1, i+5).toFloat() * 10);  // skaler opp med ti, slik at vi har int's, og legg den inn i lista
          localTide.Time[listIndex] = tmConvert_t(payload.substring(i+13, i+17).toInt(), payload.substring(i+18, i+20).toInt(), payload.substring(i+21, i+23).toInt(), payload.substring(i+24, i+26).toInt(),00,00);               // Bruk funskjon til å gjøre om substringsene i XML til time_t formatet og legg i listen
          //                                        year                                      month                                 day                                          hour                      (data is per hour, so minute and second is 00)
         
          //Serial.print("waterlevel: "); Serial.println(localTide.Level[listIndex]);
          //Serial.print("epoch time: "); Serial.println(localTide.Time[listIndex]); 
          //Serial.print("Date substrings: year: "); Serial.print(payload.substring(i+13, i+17).toInt()); Serial.print(" month: "); Serial.print(payload.substring(i+18, i+20).toInt()); Serial.print(" day: "); Serial.print(payload.substring(i+21, i+23).toInt()); Serial.print(" hour: "); Serial.println(payload.substring(i+24, i+26).toInt());
          //Serial.println();

          listIndex++;

        }
      }

    }
    else {
      Serial.print("Error code: ");
      Serial.println(httpResponseCode);
    }
    // Free resources
    http.end();

    
  }
  else {
    Serial.println("WiFi Disconnected");
  }

return localTide;
}

String urlDate(int YYYY, byte MM, byte DD, byte addDays){
  byte days[] = {31, 28, 31, 30, 31, 30, 31, 31, 30, 31, 30, 31};
  byte dd = DD + addDays;
  byte mm = MM;
  int yyyy = YYYY;

  while(dd > days[mm-1]){  // hvis dag-delen av datoen er større en antall dager den måneden (trekker fra en for å 0-indeksere måneden)
    dd = dd-days[mm-1];     // trekk fra antall dager den mæneden
    mm++;                  // inc måneden
  }

  if(mm > 12){     // aint no way noen legger til mer enn ett år med data
    mm = mm - 12;  // trekk fra månedene fra forrige år
    yyyy++;        // increment år
  }

  // Shape: &fromtime=2024-06-13T00%3A00&totime=2024-06-20T00%3A00
  String retString = "&fromtime=";
  retString = retString + YYYY; 
  retString = retString + "-";
  if(MM < 10){retString = retString + "0";}
  retString = retString + MM;
  retString = retString + "-";
  if(DD < 10){retString = retString + "0";}
  retString = retString + DD;
  retString = retString + "T00%3A00&totime=";

  retString = retString + yyyy;
  retString = retString + "-";
  if(mm < 10){retString = retString + "0";}
  retString = retString + mm;
  retString = retString + "-";
  if(dd < 10){retString = retString + "0";}
  retString = retString + dd;
  retString = retString + "T00%3A00";

  return retString;
}


time_t tmConvert_t(int YYYY, byte MM, byte DD, byte hh, byte mm, byte ss){
  tmElements_t te;  //Time elements structure
  time_t unixTime; // a time stamp te.Second = 0;

  te.Second = ss;
  te.Minute = mm;
  te.Hour = hh; //11 pm
  te.Day = DD;
  te.Month = MM;
  te.Year = YYYY - 1970; //Y2K, in seconds = 946684800UL

  unixTime =  makeTime(te);
  return unixTime; 
}

const char Ln1[] = "Iver Iscariot's";
const char Ln2[] = "Tide Watch";
void bootScreen(){
  display.setRotation(screenRot);
  display.setFont(&FreeMonoBold9pt7b);
  display.setTextColor(GxEPD_BLACK);

  // ------------------ splash screen ---------------
  display.setFullWindow();
  display.firstPage();
  do
  {
    display.fillScreen(GxEPD_WHITE);
    display.setCursor(20, 20);
    display.print(Ln1);
    display.setCursor(35, 35);
    display.print(Ln2);
    display.drawInvertedBitmap(25, 35, cat, 150, 145, GxEPD_BLACK);
    

  }
  while (display.nextPage());
  delay(5000);
  
  // ------------ draw normal screen ---------------------
  
  display.clearScreen(0); // black
  display.firstPage();
  
  do
  {
    display.fillScreen(GxEPD_WHITE);
    display.setCursor(12, 100);
    display.setTextSize(2);
    display.print(rtc.getTime()); 
    Serial.println(rtc.getTime()); 
    
  }
  while (display.nextPage());

  display.hibernate();
}

void clockUpdate(){
  bool nonSec = 0;  // hcis vi oppdaterer noe annet enn sekundet, må vi flashe skjermen litt ekstra
  display.setRotation(screenRot);
  display.setFont(&FreeMonoBold9pt7b);
  display.setTextSize(2);
  
  // -------- decide on the size of the partial update ----------
  if(rtc.getMinute() == 0 && rtc.getSecond() < 10){  // hvis vi har bikket timen
    display.setPartialWindow(0, 75, 200, 30);
    nonSec = 1;
  } 
  else if(rtc.getSecond() < 10){  // hvis vi har bikket minuttet
    display.setPartialWindow(65, 75, 200-65, 30);
    nonSec = 1;
  }
  else{
    display.setPartialWindow(135, 75, 200-135, 30);
  }

  // --------- print clock -------------
  display.firstPage();

  do{display.fillScreen(GxEPD_BLACK); display.setTextColor(GxEPD_WHITE); display.setCursor(12, 100); display.print(rtc.getTime()); }
  while (display.nextPage());
  if(nonSec == 1){
    do{display.fillScreen(GxEPD_WHITE); display.setTextColor(GxEPD_BLACK); display.setCursor(12, 100); display.print(rtc.getTime()); }
    while (display.nextPage());
    do{display.fillScreen(GxEPD_BLACK); display.setTextColor(GxEPD_WHITE); display.setCursor(12, 100); display.print(rtc.getTime()); }
    while (display.nextPage());
    do{display.fillScreen(GxEPD_WHITE); display.setTextColor(GxEPD_WHITE); display.setCursor(12, 100); display.print(rtc.getTime()); }
    while (display.nextPage());
    do{display.fillScreen(GxEPD_BLACK); display.setTextColor(GxEPD_WHITE); display.setCursor(12, 100); display.print(rtc.getTime()); }
    while (display.nextPage());
  }

  do
  {
    display.fillScreen(GxEPD_WHITE);
    display.setTextColor(GxEPD_BLACK);
    display.setCursor(12, 100);
    display.print(rtc.getTime());  
    Serial.println(rtc.getTime());
    
  }
  while (display.nextPage());
  
  display.hibernate();
}

void drawCurve(){
  display.setPartialWindow(0, 110, 200, 90);  // bit under klokken
  display.firstPage();

  int tideMax = 0;
  int tideMin = 10000;
  // find min and max values
  for ( int i = 0; i < 24; i++ ){
		if ( tideData.Level[i] > tideMax ){
			tideMax = tideData.Level[i];
		}
		if ( tideData.Level[i] < tideMin ){
			tideMin = tideData.Level[i];
		}
	}



  do
  {
    display.fillScreen(GxEPD_WHITE);
    display.setTextColor(GxEPD_BLACK);

    for(int i = 0; i < 24; i++ ){
      display.drawLine(i*8, map(tideData.Level[i],tideMax,tideMin,115,195), (i+1)*8, map(tideData.Level[i+1],tideMax,tideMin,115,195), GxEPD_BLACK);
      display.drawLine(i*8, map(tideData.Level[i],tideMax,tideMin,115,195)-1, (i+1)*8, map(tideData.Level[i+1],tideMax,tideMin,115,195)-1, GxEPD_BLACK);  // draw line one lower to thicken
      display.drawLine(i*8, map(tideData.Level[i],tideMax,tideMin,115,195)+1, (i+1)*8, map(tideData.Level[i+1],tideMax,tideMin,115,195)+1, GxEPD_BLACK);  // draw line one lower to thicken
      display.drawLine(i*8 + 1, map(tideData.Level[i],tideMax,tideMin,115,195)-1, (i+1)*8 +1 , map(tideData.Level[i+1],tideMax,tideMin,115,195)-1, GxEPD_BLACK);  // draw line one lower to thicken
    }
    
  }
  while (display.nextPage());
  
  display.hibernate();
}



void loop() {
  delay(5000);
  Serial.println(rtc.getTime());
  clockUpdate();
  if(rtc.getMinute() % 15 == 0){
    drawCurve();
  }
}